/**
 *
 * Driver to bit-bang pulse trains for ws2812s-style RGB LEDs
 *
 * Sourced from data from
 * https://wp.josh.com/2014/05/13/ws2812-neopixels-are-not-so-finicky-once-you-get-to-know-them/
 * and
 * https://github.com/lavallc/nrf51-neopixel
 *
 * @date 6/22/2019
 * @author hamster
 *
 */


#include "common.h"
#include "ws2812b.h"


WS2812S::WS2812S(uint16_t numPixels){

    // Set the port as output
    nrf_gpio_cfg_output(PIXELS_DOUT_PIN);

    this->numPixels = numPixels;
    for(int i = 0; i < numPixels; i++){
        this->pixels.push_back({ 0, 0, 0 });
    }

    if(PIXELS_DOUT_PIN > 32){
        outreg = NRF_P1;
        pin = PIXELS_DOUT_PIN - 32;
    }
    else{
        outreg = NRF_P0;
        pin = PIXELS_DOUT_PIN;
    }

}

/**
 * Set the color of the pixel at a certain index
 * @param pixel which index
 * @param red color
 * @param green color
 * @param blue color
 */
void WS2812S::setColor(uint16_t pixel, uint8_t red, uint8_t green, uint8_t blue){
    setColor(pixel, { red, green, blue});
}
void WS2812S::setColor(uint16_t pixel, PIXEL color){
    if(pixel > numPixels){
        // Out of bounds, ignore
        return;
    }
    this->pixels[pixel] = color;
}

/**
 * Show the LED pixels
 *
 * For strips longer than a few pixels, you want to do this when the radio is not busy
 */
void WS2812S::show(){
    nrf_gpio_pin_clear(PIXELS_DOUT_PIN);
    nrf_delay_us(50);

    for(auto pixel : this->pixels){
        sendByte(pixel.green);
        sendByte(pixel.red);
        sendByte(pixel.blue);
    }
}

/**
 * Reverse the byte, then send it bit by bit
 * @param byte
 */
void WS2812S::sendByte(unsigned char byte){

    unsigned char sendByte = reverseByte(byte);

    for(unsigned char bit = 0 ; bit < 8 ; bit++){
        sendBit(sendByte & 0x01);
        sendByte >>= 1;
    }

}

/**
 * Encode the bit val into a pulse to the DOUT
 * @param bitVal
 */
void WS2812S::sendBit(bool bitVal){

    if(bitVal){
        // 1 bit
        // Timing here is not critical, it just has to be at least 550ns long
        outreg->OUTSET = (1UL << pin);
        for(int i = 0; i < 20; i++) {
            __NOP();
        }
        outreg->OUTCLR = (1UL << pin);

    }
    else{
        // 0 bit
        // Timing here is tighter.  The pulse needs to be at least 200ns but less than 500ns long
        outreg->OUTSET = (1UL << pin);
        __NOP();
        __NOP();
        __NOP();
        __NOP();
        __NOP();
        __NOP();
        __NOP();
        __NOP();
        outreg->OUTCLR = (1UL << pin);

    }
}


/**
 * Fast lookup table for reversing a single byte
 *
 * @param byte The byte to reverse
 * @return byte, bit-wise reversed
 */
unsigned char WS2812S::reverseByte(unsigned char byte){

    static const unsigned char table[] = {
            0x00, 0x80, 0x40, 0xc0, 0x20, 0xa0, 0x60, 0xe0,
            0x10, 0x90, 0x50, 0xd0, 0x30, 0xb0, 0x70, 0xf0,
            0x08, 0x88, 0x48, 0xc8, 0x28, 0xa8, 0x68, 0xe8,
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            0x1f, 0x9f, 0x5f, 0xdf, 0x3f, 0xbf, 0x7f, 0xff,
    };
    return table[byte];
}

